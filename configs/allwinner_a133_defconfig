## configs/allwinner_a133_defconfig
```kconfig
CONFIG_ARM=y
CONFIG_ARCH_SUNXI=y
CONFIG_MACH_SUN50I_A133=y

CONFIG_DRAM_CLK=576

CONFIG_DEFAULT_DEVICE_TREE="sun50i-h616-orangepi-zero2"

CONFIG_SPL=y
CONFIG_SPL_SHOW_ERRORS=y
CONFIG_SPL_MAX_SIZE=0xbfa0
CONFIG_SPL_STACK=0x45000
CONFIG_SPL_I2C=y
CONFIG_SPL_SYS_I2C_LEGACY=y

CONFIG_DRAM_SUN50I_A133_CA_BIT_DELAY_COMPENSATION=y
CONFIG_DRAM_SUN50I_A133_DX_BIT_DELAY_COMPENSATION=y
CONFIG_DRAM_SUN50I_A133_WRITE_LEVELING=y
CONFIG_DRAM_SUN50I_A133_READ_CALIBRATION=y
CONFIG_DRAM_SUN50I_A133_READ_TRAINING=y
CONFIG_DRAM_SUN50I_A133_WRITE_TRAINING=y

CONFIG_MMC0_CD_PIN="PF6"
CONFIG_R_I2C_ENABLE=y
# CONFIG_SYS_MALLOC_CLEAR_ON_INIT is not set
CONFIG_SYS_PBSIZE=1024
CONFIG_SYS_BOOTM_LEN=0x2000000
CONFIG_SYS_I2C_MVTWSI=y
CONFIG_SYS_I2C_SLAVE=0x7f
CONFIG_SYS_I2C_SPEED=400000
CONFIG_SPI_FLASH_MACRONIX=y
CONFIG_PHY_REALTEK=y
CONFIG_SUN8I_EMAC=y
CONFIG_SPI=y
```
